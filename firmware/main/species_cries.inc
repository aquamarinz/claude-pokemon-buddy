// AUTO-GENERATED by host/scripts/gen-cries.mjs from host/seed/species-cries.json
// Do not edit by hand. Regenerate: cd host && node scripts/gen-cries.mjs
#define SND_SPECIES_BASE 3
#define SND_SPECIES_COUNT 18

static const Note SPECIES_CRY_0[] = { {520.f, 780.f, 110}, {0.f, 0.f, 40}, {760.f, 1150.f, 130} }; // eevee -> sound id 3
static const Note SPECIES_CRY_1[] = { {600.f, 900.f, 150}, {900.f, 700.f, 130} }; // vaporeon -> sound id 4
static const Note SPECIES_CRY_2[] = { {1200.f, 1450.f, 45}, {1450.f, 1200.f, 45}, {1200.f, 1450.f, 45}, {1450.f, 1200.f, 45}, {1450.f, 950.f, 75} }; // jolteon -> sound id 5
static const Note SPECIES_CRY_3[] = { {740.f, 520.f, 150}, {0.f, 0.f, 35}, {560.f, 360.f, 170} }; // flareon -> sound id 6
static const Note SPECIES_CRY_4[] = { {700.f, 1040.f, 120}, {0.f, 0.f, 40}, {1040.f, 1320.f, 150} }; // espeon -> sound id 7
static const Note SPECIES_CRY_5[] = { {300.f, 300.f, 150}, {0.f, 0.f, 45}, {260.f, 230.f, 170} }; // umbreon -> sound id 8
static const Note SPECIES_CRY_6[] = { {560.f, 640.f, 110}, {0.f, 0.f, 40}, {620.f, 540.f, 130} }; // leafeon -> sound id 9
static const Note SPECIES_CRY_7[] = { {1500.f, 1500.f, 70}, {0.f, 0.f, 35}, {1700.f, 1180.f, 150} }; // glaceon -> sound id 10
static const Note SPECIES_CRY_8[] = { {780.f, 780.f, 130}, {0.f, 0.f, 30}, {990.f, 990.f, 150} }; // sylveon -> sound id 11
static const Note SPECIES_CRY_9[] = { {540.f, 700.f, 110}, {0.f, 0.f, 40}, {620.f, 800.f, 130} }; // bulbasaur -> sound id 12
static const Note SPECIES_CRY_10[] = { {460.f, 600.f, 110}, {0.f, 0.f, 40}, {560.f, 720.f, 120}, {720.f, 560.f, 90} }; // ivysaur -> sound id 13
static const Note SPECIES_CRY_11[] = { {300.f, 380.f, 150}, {0.f, 0.f, 40}, {360.f, 300.f, 130}, {0.f, 0.f, 40}, {300.f, 280.f, 140} }; // venusaur -> sound id 14
static const Note SPECIES_CRY_12[] = { {900.f, 520.f, 90}, {0.f, 0.f, 30}, {660.f, 400.f, 140} }; // charmander -> sound id 15
static const Note SPECIES_CRY_13[] = { {720.f, 700.f, 35}, {560.f, 580.f, 35}, {0.f, 0.f, 30}, {760.f, 360.f, 160}, {320.f, 260.f, 100} }; // charmeleon -> sound id 16
static const Note SPECIES_CRY_14[] = { {300.f, 280.f, 70}, {280.f, 320.f, 60}, {0.f, 0.f, 30}, {420.f, 230.f, 180}, {260.f, 700.f, 170} }; // charizard -> sound id 17
static const Note SPECIES_CRY_15[] = { {640.f, 920.f, 90}, {0.f, 0.f, 35}, {900.f, 1180.f, 70}, {1180.f, 720.f, 55} }; // squirtle -> sound id 18
static const Note SPECIES_CRY_16[] = { {520.f, 760.f, 120}, {760.f, 1000.f, 90}, {0.f, 0.f, 35}, {900.f, 560.f, 130} }; // wartortle -> sound id 19
static const Note SPECIES_CRY_17[] = { {440.f, 640.f, 130}, {0.f, 0.f, 40}, {600.f, 360.f, 120}, {0.f, 0.f, 35}, {300.f, 210.f, 150} }; // blastoise -> sound id 20

struct SpeciesCry { const Note *notes; int count; };
static const SpeciesCry SPECIES_CRIES[SND_SPECIES_COUNT] = {
  { SPECIES_CRY_0, 3 }, // eevee
  { SPECIES_CRY_1, 2 }, // vaporeon
  { SPECIES_CRY_2, 5 }, // jolteon
  { SPECIES_CRY_3, 3 }, // flareon
  { SPECIES_CRY_4, 3 }, // espeon
  { SPECIES_CRY_5, 3 }, // umbreon
  { SPECIES_CRY_6, 3 }, // leafeon
  { SPECIES_CRY_7, 3 }, // glaceon
  { SPECIES_CRY_8, 3 }, // sylveon
  { SPECIES_CRY_9, 3 }, // bulbasaur
  { SPECIES_CRY_10, 4 }, // ivysaur
  { SPECIES_CRY_11, 5 }, // venusaur
  { SPECIES_CRY_12, 3 }, // charmander
  { SPECIES_CRY_13, 5 }, // charmeleon
  { SPECIES_CRY_14, 5 }, // charizard
  { SPECIES_CRY_15, 4 }, // squirtle
  { SPECIES_CRY_16, 4 }, // wartortle
  { SPECIES_CRY_17, 5 }, // blastoise
};
