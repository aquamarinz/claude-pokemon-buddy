## firmware/sdkconfig.defaults
```kconfig
CONFIG_IDF_TARGET="esp32s3"

# Flash: 16MB QIO @ 80MHz (matches Waveshare ESP32-S3-RLCD-4.2)
CONFIG_ESPTOOLPY_FLASHMODE_QIO=y
CONFIG_ESPTOOLPY_FLASHFREQ_80M=y
CONFIG_ESPTOOLPY_FLASHSIZE_16MB=y

# OPI (octal) PSRAM — display_bsp allocates DispBuffer + pixel LUTs in SPIRAM,
# so PSRAM MUST be up or RLCD_Init's assert(DispBuffer) crashes at boot.
CONFIG_SPIRAM=y
CONFIG_SPIRAM_MODE_OCT=y
CONFIG_SPIRAM_SPEED_80M=y
```
